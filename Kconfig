## Kconfig
```kconfig
# SPDX-License-Identifier: MIT
rsource "drivers/pmw3610/Kconfig"

config BOBTAIL_DISCONNECT_INACTIVE_HOSTS
    bool "Disconnect hosts outside the selected Bluetooth profile"
    depends on ZMK_BLE && ZMK_SPLIT_ROLE_CENTRAL && SETTINGS && SETTINGS_DYNAMIC_HANDLERS
    select BT_FILTER_ACCEPT_LIST
    default n

config BOBTAIL_PAIRING_DIAGNOSTICS
    bool "Record host Bluetooth pairing results for the diagnostic key"
    depends on ZMK_BLE && BT_SMP && ZMK_SPLIT_ROLE_CENTRAL
    default n

config BOBTAIL_PROFILE_BLE_NAMES
    bool "Include the selected profile number in the Bluetooth name"
    depends on ZMK_BLE && ZMK_SPLIT_ROLE_CENTRAL && SETTINGS && SETTINGS_DYNAMIC_HANDLERS
    select BT_DEVICE_NAME_DYNAMIC
    default n

config BOBTAIL_CLOCK_DIAGNOSTIC
    bool "Allow an on-demand HF crystal clock diagnostic"
    depends on CLOCK_CONTROL_NRF && SOC_SERIES_NRF52X && ZMK_SPLIT_ROLE_CENTRAL
    default n
    help
      Enable diagnostic keys to compare clock management without reflashing.

config BOBTAIL_KEEP_HFXO_ON
    bool "Keep the HF crystal clock running at startup"
    depends on BOBTAIL_CLOCK_DIAGNOSTIC
    default n
    help
      Keep one reference to the HF crystal clock, as USB attachment does.
      This avoids clock start/stop on battery but increases power consumption.
```

## dts/bindings/behaviors/bobtail,behavior-device-diagnostics.yaml
```yaml
# SPDX-License-Identifier: MIT
description: Type device uptime, boot reset cause and clock diagnostic state on demand
compatible: "bobtail,behavior-device-diagnostics"
include: one_param.yaml
```

## dts/bindings/behaviors/bobtail,behavior-scroll-speed.yaml
```yaml
# SPDX-License-Identifier: MIT
description: Adjust the trackball wheel speed by one bounded step
compatible: "bobtail,behavior-scroll-speed"
include: one_param.yaml
```
